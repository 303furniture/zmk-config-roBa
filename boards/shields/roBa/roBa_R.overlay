#include <dt-bindings/input/input-event-codes.h>

&spi0 {
    status = "okay";
    compatible = "nordic,nrf-spim";
    /* 修正ポイント1: XIAO BLEでは標準設定が定義されているため、pinctrlを削除します */
    /delete-property/ pinctrl-0;
    /delete-property/ pinctrl-1;
    /delete-property/ pinctrl-names;

    cs-gpios = <&gpio0 9 GPIO_ACTIVE_LOW>;

    trackball: trackball@0 {
        status = "okay";
        compatible = "pixart,pmw3610";
        reg = <0>;
        spi-max-frequency = <2000000>;

        /* 修正ポイント2: 軸の指定は &input_relay などの参照ではなく、数値やマクロが正しく使われている必要があります */
        zephyr,axis-x = <INPUT_REL_X>;
        zephyr,axis-y = <INPUT_REL_Y>;

        /* 修正ポイント3: ピン番号の確認。roBaの設計に合わせて修正してください */
        /* 多くの場合、P0.05（D1）などが使われますが、ご提示の &gpio0 2 で動作するか確認してください */
        motion-gpios = <&gpio0 2 (GPIO_ACTIVE_LOW | GPIO_PULL_UP)>;

        scroll-layers = <5>;
    };
};